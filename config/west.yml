## config/west.yml
```yaml
manifest:  
  remotes:  
    - name: zmkfirmware  
      url-base: https://github.com/zmkfirmware  
    - name: na-ka-no
      url-base: https://github.com/na-ka-no
    - name: kloir-z
      url-base: https://github.com/kloir-z
    - name: caksoylar
      url-base: https://github.com/caksoylar
    - name: kot149
      url-base: https://github.com/kot149
  
  projects:  
    - name: zmk
      remote: na-ka-no  # フォークしたリポジトリを参照  
      revision: for-cool642tb_mini  # カスタムブランチ名  
      import: app/west.yml  
    - name: zmk-pmw3610-driver
      remote: kloir-z
      revision: scroll-acceleration-feature
    - name: zmk-rgbled-widget
      remote: caksoylar
      revision: main
    - name: zmk-layout-shift
      remote: kot149
      revision: v2
  
  self:  
    path: config
```
